## boards/shields/eyelash_sofle_left/Kconfig.defconfig
```kconfig
if SHIELD_EYELASH_SOFLE_LEFT

config ZMK_SPLIT
    default y

config ZMK_SPLIT_ROLE_CENTRAL
    default n

endif
```

## boards/shields/eyelash_sofle_left/Kconfig.shield
```kconfig
config SHIELD_EYELASH_SOFLE_LEFT
    def_bool $(shields_list_contains,eyelash_sofle_left)
```

## boards/shields/eyelash_sofle_right/Kconfig.shield
```kconfig
config SHIELD_EYELASH_SOFLE_RIGHT
    def_bool $(shields_list_contains,eyelash_sofle_right)
```
